## blink-plus-uart/drivers/kionix/Kconfig
```kconfig
# comment "Kionix drivers"

if KIONIX
rsource "kx132-1211/Kconfig"
endif # KIONIX
```

## blink-plus-uart/drivers/kionix/kx132-1211/Kconfig
```kconfig
# Kionix KX132-1211 accelerometer configuration options

# menuconfig KX132-1211
menuconfig KX132_1211
    bool "KX132-1211 three axis accelerometer"
    depends on (I2C && HAS_DTS_I2C)
    help
      Enable I2C based driver for Kionix KX132-1211 accelerometer (SPI driver not yet implemented - TMH)

if KX132_1211

config KX132_1211_DRV_NAME
        string "Kionix KX132-1211 Driver name"
        default "KX132-1211"
        help
          This option sets the driver name

endif # KX132_1211
```

## driver-work-v2/Kconfig
```kconfig
#
# Copyright (c) 2021 Neela Nurseries
#

menu "Kionix sensor drivers"
rsource "drivers/Kconfig"
# rsource "lib/Kconfig"
endmenu
```

## driver-work-v2/drivers/kionix/kx132-1211/Kconfig
```kconfig
#
# Copyright (c) 2021 Neela Nurseries
#

menuconfig KX132-1211
	bool "Kionix 3-axis acceleromter"
	depends on I2C
	help
	  Enable driver for Kionix 3-axis acceleromter

if KX132_1211

config KX132_1211_DRV_NAME
	string "Kionix KX132-1211 Driver's name"
	default "KX132-1211"
	help
	  This option sets the driver name

endif # KX132_1211
```

## driver-work-v2/dts/bindings/kionix,kx132-1211.yml
```yaml
#
# Copyright (c) 2021 Neela Nurseries
#

description:  Kionix 3-axis accelerometer

compatible: "kionix,kx132-1211"

include: i2c-device.yaml
```

## kionix-work/Kconfig
```kconfig
# Copyright (c) 2021 <team name here>
# SPDX-License-Identifier: Apache-2.0
#
# This Kconfig file is picked by the Zephyr build system because it is defined
# as the module Kconfig entry point (see zephyr/module.yml). You can browse
# module options by going to Zephyr -> Modules in Kconfig.

menu "Kionix driver"
rsource "drivers/Kconfig"
endmenu
```

## kionix-work/drivers/Kconfig
```kconfig
# SPDX-License-Identifier: Apache-2.0

menu "Kionix driver"
rsource "kionix/Kconfig"
endmenu
```

## kionix-work/drivers/kionix/Kconfig
```kconfig
# SPDX-License-Identifier: Apache-2.0

#if KIONIX
menu "Kionix 1211"
rsource "kx132-1211/Kconfig"
endmenu
#endif # KIONIX
```

## kionix-work/drivers/kionix/kx132-1211/Kconfig
```kconfig
# SPDX-License-Identifier: Apache-2.0

config KX132_1211
	bool "KX132-1211 accelerometer"
	depends on I2C
	help
	  Enable Kionix KX132-1211 accelerometer
```

## kionix-work/west.yml
```yaml
# Copyright (c) 2021 <team name here>
# SPDX-License-Identifier: Apache-2.0

manifest:
  self:
    path: kionix-work

  remotes:
    - name: zephyrproject-rtos
      url-base: https://github.com/zephyrproject-rtos

  projects:
    - name: zephyr
      remote: zephyrproject-rtos
      revision: main
      import: true
```
