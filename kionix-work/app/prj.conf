## CMakeLists.txt
```
#-------------------------------------------------------------------------------
# Kionix work, based on 'Zephyr Example Application'
#
# Copyright (c) <team name here>
# SPDX-License-Identifier: Apache-2.0


## https://cmake.org/cmake/help/latest/command/project.html


cmake_minimum_required(VERSION 3.13.1)
find_package(Zephyr REQUIRED HINTS $ENV{ZEPHYR_BASE})

## project(app LANGUAGES C VERSION 1.0.0)
## Reference https://cmake.org/cmake/help/latest/command/project.html
project(kionix-work LANGUAGES C VERSION 1.0.0)

## configure_file(app_version.h.in ${CMAKE_BINARY_DIR}/app/include/app_version.h)
## Reference https://cmake.org/cmake/help/latest/command/configure_file.html
## @brief from cmake:  "Copy a file to another location and modify its contents."
configure_file(kionix_work_version.h.in ${CMAKE_BINARY_DIR}/app/include/kionix_work_version.h)

target_include_directories(app PRIVATE ${CMAKE_BINARY_DIR}/app/include src)
## Reference https://cmake.org/cmake/help/latest/command/target_include_directories.html
## target_include_directories(kionix-work PRIVATE ${CMAKE_BINARY_DIR}/app/include src)

target_sources(app PRIVATE src/main.c)
## Reference https://cmake.org/cmake/help/latest/command/target_sources.html
## target_sources(kionix-work PRIVATE src/main.c)
```

## Kconfig
```
# Copyright (c) 2021 <team name here>
# SPDX-License-Identifier: Apache-2.0
#
# This file is the application Kconfig entry point. All application Kconfig
# options can be defined here or included via other application Kconfig files.
# You can browse these options using the west targets menuconfig (terminal) or
# guiconfig (GUI).

menu "Driver example"
rsource "../drivers/Kconfig"
endmenu

menu "Zephyr"
source "Kconfig.zephyr"
endmenu

module = KIONIX-WORK
module-str = Kionix-work
source "subsys/logging/Kconfig.template.log_config"
```

## prj.conf
```kconfig
# Copyright (c) 2021 <team name here>
# SPDX-License-Identifier: Apache-2.0
#
# This file contains selected Kconfig options for the application.

CONFIG_GPIO=y
CONFIG_STDOUT_CONSOLE=y
CONFIG_I2C=y
CONFIG_SENSOR=y

## 2021-08-02 adding stanza per https://learn.sparkfun.com/tutorials/nrf9160-thing-plus-hookup-guide#example---blinky:
## ( This option set yes until we get Segger programmer working - TMH )
CONFIG_BOOTLOADER_MCUBOOT=y

## 2021-08-17 adding configuration flag to enable Kionix driver under CP IIoT development:
CONFIG_KX132_1211=y

# trivial addition, testing github authentication - TMH
```

## src/main.c
```c
/*
 * Copyright (c) 2016 Intel Corporation
 *
 * SPDX-License-Identifier: Apache-2.0
 */

#include <zephyr.h>
#include <device.h>
#include <devicetree.h>
#include <drivers/gpio.h>

// 2021-08-06 - blink-custom first addition of Zephyr functionality:
#include <sys/printk.h>



/* 1000 msec = 1 sec */
#define SLEEP_TIME_MS   1500 // 1000

/* The devicetree node identifier for the "led0" alias. */
#define LED0_NODE DT_ALIAS(led0)

#if DT_NODE_HAS_STATUS(LED0_NODE, okay)
#define LED0     DT_GPIO_LABEL(LED0_NODE, gpios)
#define PIN      DT_GPIO_PIN(LED0_NODE, gpios)
#define FLAGS    DT_GPIO_FLAGS(LED0_NODE, gpios)
#else
/* A build error here means your board isn't set up to blink an LED. */
#error "Unsupported board: led0 devicetree alias is not defined"
#define LED0    ""
#define PIN      0
#define FLAGS    0
#endif

// 2021-08-17 - adding symbol to allow for enabling local driver under development:
#define KX132_1211




void query_kx132_id(const struct device *dev_ptr_accelerometer, unsigned int options)
{

    if ( dev_ptr_accelerometer != NULL ) { }

    if ( options > 0 ) { }

}


void main(void)
{
    const struct device *dev;
    bool led_is_on = true;
    int ret;
    int main_loop_count = 0;

    dev = device_get_binding(LED0);
    if (dev == NULL) {
        return;
    }

    ret = gpio_pin_configure(dev, PIN, GPIO_OUTPUT_ACTIVE | FLAGS);
    if (ret < 0) {
        return;
    }


    const struct device *dev_accelerometer;
    dev_accelerometer = DEVICE_DT_GET(DT_NODELABEL(kionix_sensor));
    if (dev_accelerometer == NULL) {
        printk("Failed to init Kionix sensor device pointer!\n");
        printk("firmware exiting early, done.\n\n");
        return;
    }
    else
    {
        printk("- SUCCESS - assigned Kionix accelerometer device to pointer,\n");
    }


// 2021-08-11 WED - 
    query_kx132_id(dev_accelerometer, 0);



    while (1) {
        gpio_pin_set(dev, PIN, (int)led_is_on);
        led_is_on = !led_is_on;
        k_msleep(SLEEP_TIME_MS);

//        if ( led_is_on == 0 )
        if ( (main_loop_count % 3) == 0 )
        {
            printk("Hello World! %s\n\n", CONFIG_BOARD);
        }
        else
        {
            printk("Hello World! %s\n", CONFIG_BOARD);
        }

        ++main_loop_count;
    }
}
```
